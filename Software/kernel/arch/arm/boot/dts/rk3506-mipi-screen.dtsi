
// 默认使用720P,RK3506最大仅支持800x1280分辨率。下面两个宏二选一，使用不同的屏就打开对应屏宏即可，同时需要注释另一个宏
//#define ATK_MIPI_5P5_720P
//#define ATK_MIPI_10P1_800P 
#define LEE_MIPI_3P0_480P // add by nanshou

#if defined(LEE_MIPI_3P0_480P)

/*****************************************************
* b站搜索 楠瘦
* 点点关注不迷路。
* 链接：https://space.bilibili.com/299565124
******************************************************/
&dsi {
    status = "okay"; // DSI1控制器状态
    myflag = "3p0_480p_by_nanshou";
    // rockchip,lane-rate = <480>; // DSI1通道速率
    dsi1_panel: panel@0 {
        // dsi,lanes  = <2>; // DSI通道数
       panel-init-sequence = [
            39 00 06 FF 77 01 00 00 13 
            15 00 02 EF 08 
            39 00 06 FF 77 01 00 00 10 
            39 00 03 C0 E9 03 
            39 00 03 C1 0F 0C 
            39 00 03 C2 27 0A
            15 00 02 CC 10 
            39 00 11 B0 00 23 2A 0A 0E 03 12 06 06 2A 00 10 0F 2D 34 1F
            39 00 11 B1 00 24 2B 0F 12 07 15 0A 0A 2B 08 13 10 2D 33 1F
            39 00 06 FF 77 01 00 00 11 
            15 00 02 B0 5D
            15 00 02 B1 74
            15 00 02 B2 84 
            15 00 02 B3 80 
            15 00 02 B5 45 
            15 00 02 B7 85 
            15 00 02 B8 33 
            15 00 02 C1 78 
            15 00 02 C2 78 
            15 64 02 D0 88 
            39 00 04 E0 00 00 02 
            39 00 0C E1 06 A0 08 A0 05 A0 07 A0 00 44 44 
            39 00 0D E2 30 30 44 44 6E A0 00 00 6E A0 00 00
            39 00 05 E3 00 00 33 33 
            39 00 03 E4 44 44 
            39 00 11 E5 0D 69 0A A0 0F 6B 0A A0 09 65 0A A0 0B 67 0A A0 
            39 00 05 E6 00 00 33 33 
            39 00 03 E7 44 44 
            39 00 11 E8 0C 68 0A A0 0E 6A 0A A0 08 64 0A A0 0A 66 0A A0 
            39 00 03 E9 36 00 
            39 00 08 EB 00 01 E4 E4 44 88 40 
            39 00 11 ED FF 45 67 FA 01 2B CF FF FF FC B2 10 AF 76 54 FF
            39 00 07 EF 10 0D 04 08 3F 1F 
            39 00 06 FF 77 01 00 00 00 
            15 00 02 36 00 
            15 00 02 3A 77
            05 78 01 11 
            05 14 01 29 
        ]; // mipi初始化序列
        panel-exit-sequence = [
                05 00 01 28
                05 00 01 10
        ]; // 面板退出序列

        disp_timings1: display-timings {
            native-mode = <&dsi1_timing0>;
            dsi1_timing0: timing0 {
                clock-frequency = <27000000>; // 时钟频率
                hactive = <480>; // 水平像素
                vactive = <854>; // 垂直像素
                hfront-porch = <8>; // 水平前廊
                hsync-len = <2>; // 水平同步长度
                hback-porch = <43>; // 水平后廊
                vfront-porch = <4>; // 垂直前廊
                vsync-len = <10>; // 垂直同步长度
                vback-porch = <42>; // 垂直后廊
                hsync-active = <0>; // 水平同步极性激活
                vsync-active = <0>; // 垂直同步极性激活
                de-active = <0>; // 数据使能极性激活
                pixelclk-active = <1>; // 像素时钟极性激活
            };
        };
    };
};
#endif

#if defined(ATK_MIPI_5P5_720P)
&dsi {
	status = "okay";
        dsi_panel: panel@0 {
                panel-init-sequence = [
                        39 00 04 B9 FF 83 94
                        //15 00 02 36 01(倒向显示)
                        //15 00 02 36 02(正向显示)
                        15 00 02 36 01
                        39 00 07 BA 61 03 68 6B B2 C0
                        39 00 0B B1 48 12 72 09 32 54 71 71 57 47
                        39 00 07 B2 00 80 64 0C 0D 2F
                        39 00 16 B4 73 74 73 74 73 74 01 0C 86 75 00 3F 73 74 73 74 73 74 01 0C 86
                        39 00 03 B6 6E 6E
                        39 00 22 D3 00 00 07 07 40 07 0C 00 08 10 08 00 08 54 15 0A 05 0A 02 15 06 05 06 47 44 0A 0A 4B 10 07 07 0C 40
                        39 00 2D D5 1C 1C 1D 1D 00 01 02 03 04 05 06 07 08 09 0A 0B 24 25 18 18 26 27 18 18 18 18 18 18 18 18 18 18 18 18 18 18 18 18 20 21 18 18 18 18
                        39 00 2D D6 1C 1C 1D 1D 07 06 05 04 03 02 01 00 0B 0A 09 08 21 20 18 18 27 26 18 18 18 18 18 18 18 18 18 18 18 18 18 18 18 18 25 24 18 18 18 18
                        39 00 3B E0 00 0A 15 1B 1E 21 24 22 47 56 65 66 6E 82 88 8B 9A 9D 98 A8 B9 5D 5C 61 66 6A 6F 7F 7F 00 0A 15 1B 1E 21 24 22 47 56 65 65 6E 81 87 8B 98 9D 99 A8 BA 5D 5D 62 67 6B 72 7F 7F
                        39 00 03 C0 1F 31
                        15 00 02 CC 03
                        15 00 02 D4 02
                        15 00 02 BD 02
                        39 00 0D D8 FF FF FF FF FF FF FF FF FF FF FF FF
                        15 00 02 BD 00
                        15 00 02 BD 01
                        15 00 02 B1 00
                        15 00 02 BD 00
                        39 00 08 BF 40 81 50 00 1A FC 01
                        15 00 02 C6 ED
                        05 64 01 11
                        05 78 01 29

                ];

                disp_timings0: display-timings {
                        native-mode = <&dsi_timing0>;
                        dsi_timing0: timing0 {
                                clock-frequency = <65000000>;
                                hactive = <720>;
                                vactive = <1280>;
                                hfront-porch = <48>;
                                hsync-len = <8>;
                                hback-porch = <52>;
                                vfront-porch = <16>;
                                vsync-len = <6>;
                                vback-porch = <15>;
                                hsync-active = <0>;
                                vsync-active = <0>;
                                de-active = <0>;
                                pixelclk-active = <0>;
                        };
                };

        };
};
#endif

#if defined(ATK_MIPI_10P1_800P)
&dsi {
	status = "okay";
        dsi_panel: panel@0 {
                panel-init-sequence = [
			39 05 04 FF 98 81 03
			05 05 02 01 00
			05 05 02 02 00
			05 05 02 03 53
			05 05 02 04 D3
			05 05 02 05 00
			05 05 02 06 0D
			05 05 02 07 08
			05 05 02 08 00
			05 05 02 09 00
			05 05 02 0a 00
			05 05 02 0b 00
			05 05 02 0c 00
			05 05 02 0d 00
			05 05 02 0e 00
			05 05 02 0f 28
			05 05 02 10 28
			05 05 02 11 00
			05 05 02 12 00
			05 05 02 13 00
			05 05 02 14 00
			05 05 02 15 00
			05 05 02 16 00
			05 05 02 17 00
			05 05 02 18 00
			05 05 02 19 00
			05 05 02 1a 00
			05 05 02 1b 00
			05 05 02 1c 00
			05 05 02 1d 00
			05 05 02 1e 40
			05 05 02 1f 80
			05 05 02 20 06
			05 05 02 21 01
			05 05 02 22 00
			05 05 02 23 00
			05 05 02 24 00
			05 05 02 25 00
			05 05 02 26 00
			05 05 02 27 00
			05 05 02 28 33
			05 05 02 29 33
			05 05 02 2a 00
			05 05 02 2b 00
			05 05 02 2c 00
			05 05 02 2d 00
			05 05 02 2e 00
			05 05 02 2f 00
			05 05 02 30 00
			05 05 02 31 00
			05 05 02 32 00
			05 05 02 33 00
			05 05 02 34 03
			05 05 02 35 00
			05 05 02 36 00
			05 05 02 37 00
			05 05 02 38 96
			05 05 02 39 00
			05 05 02 3a 00
			05 05 02 3b 00
			05 05 02 3c 00
			05 05 02 3d 00
			05 05 02 3e 00
			05 05 02 3f 00
			05 05 02 40 00
			05 05 02 41 00
			05 05 02 42 00
			05 05 02 43 00
			05 05 02 44 00
			05 05 02 50 00
			05 05 02 51 23
			05 05 02 52 45
			05 05 02 53 67
			05 05 02 54 89
			05 05 02 55 AB
			05 05 02 56 01
			05 05 02 57 23
			05 05 02 58 45
			05 05 02 59 67
			05 05 02 5a 89
			05 05 02 5b AB
			05 05 02 5c CD
			05 05 02 5d EF
			05 05 02 5e 00
			05 05 02 5f 08
			05 05 02 60 08
			05 05 02 61 06
			05 05 02 62 06
			05 05 02 63 01
			05 05 02 64 01
			05 05 02 65 00
			05 05 02 66 00
			05 05 02 67 02
			05 05 02 68 15
			05 05 02 69 15
			05 05 02 6a 14
			05 05 02 6b 14
			05 05 02 6c 0D
			05 05 02 6d 0D
			05 05 02 6e 0C
			05 05 02 6f 0C
			05 05 02 70 0F
			05 05 02 71 0F
			05 05 02 72 0E
			05 05 02 73 0E
			05 05 02 74 02
			05 05 02 75 08
			05 05 02 76 08
			05 05 02 77 06
			05 05 02 78 06
			05 05 02 79 01
			05 05 02 7a 01
			05 05 02 7b 00
			05 05 02 7c 00
			05 05 02 7d 02
			05 05 02 7e 15
			05 05 02 7f 15
			05 05 02 80 14
			05 05 02 81 14
			05 05 02 82 0D
			05 05 02 83 0D
			05 05 02 84 0C
			05 05 02 85 0C
			05 05 02 86 0F
			05 05 02 87 0F
			05 05 02 88 0E
			05 05 02 89 0E
			05 05 02 8A 02
			39 05 04 FF 98 81 04
			05 05 02 6E 2B
			05 05 02 6F 37
			05 05 02 3A 24
			05 05 02 8D 1A
			05 05 02 87 BA
			05 05 02 B2 D1
			05 05 02 88 0B
			05 05 02 38 01
			05 05 02 39 00
			05 05 02 B5 02
			05 05 02 31 25
			05 05 02 3B 98
			39 05 04 FF 98 81 01
			05 05 02 22 0A
			05 05 02 31 00
			05 05 02 53 3D
			05 05 02 55 3D
			05 05 02 50 B5
			05 05 02 51 AD
			05 05 02 60 06
			05 05 02 62 20
			05 05 02 B7 03  //2 lanse
			05 05 02 A0 00
			05 05 02 A1 21
			05 05 02 A2 35
			05 05 02 A3 19
			05 05 02 A4 1E
			05 05 02 A5 33
			05 05 02 A6 27
			05 05 02 A7 26
			05 05 02 A8 AF
			05 05 02 A9 1B
			05 05 02 AA 27
			05 05 02 AB 8D
			05 05 02 AC 1A
			05 05 02 AD 1B
			05 05 02 AE 50
			05 05 02 AF 26
			05 05 02 B0 2B
			05 05 02 B1 54
			05 05 02 B2 5E
			05 05 02 B3 23
			05 05 02 C0 00
			05 05 02 C1 21
			05 05 02 C2 35
			05 05 02 C3 19
			05 05 02 C4 1E
			05 05 02 C5 33
			05 05 02 C6 27
			05 05 02 C7 26
			05 05 02 C8 AF
			05 05 02 C9 1B
			05 05 02 CA 27
			05 05 02 CB 8D
			05 05 02 CC 1A
			05 05 02 CD 1B
			05 05 02 CE 50
			05 05 02 CF 26
			05 05 02 D0 2B
			05 05 02 D1 54
			05 05 02 D2 5E
			05 05 02 D3 23
			39 05 04 FF 98 81 00
			05 05 02 11 00
			05 78 02 29 00
			05 78 02 35 00

                ];

		disp_timings0: display-timings {
			native-mode = <&dsi_timing0>;
			dsi_timing0: timing0 {
				clock-frequency = <67000000>;
				hactive = <800>;
				vactive = <1280>;
				hfront-porch = <12>;
				hsync-len = <24>;
				hback-porch = <24>;
				vfront-porch = <7>;
				vsync-len = <2>;
				vback-porch = <9>;
				hsync-active = <0>;
				vsync-active = <0>;
				de-active = <0>;
				pixelclk-active = <0>;
			};
		};

        };
};
#endif
